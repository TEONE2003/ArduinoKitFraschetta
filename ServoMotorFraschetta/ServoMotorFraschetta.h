#ifndef ServoMotorFraschetta_h
#define ServoMotorFraschetta_h
class SERVOMOTORE:Servo,MOTORE_SWIPING{
 protected:
  uint8_t PIN;
  uint16_t POSIZIONE()override{return EEPROM.read(PIN);}
  void INIZIALIZZA_SE_NON_INZIALIZZATO(){if(!attached()){attach(PIN); write(uint8_t(POSIZIONE())); delay(2);}}
  void SCRIVI_POSIZIONE(uint8_t GRADI){
   if(GRADI>180){GRADI=180;}
   INIZIALIZZA_SE_NON_INZIALIZZATO();
   write(GRADI);
   EEPROM.update(PIN,GRADI);
  }
  void AUMENTA_POSIZIONE(const uint8_t &GRADI,const uint16_t &PERIODO_IN_MILLISECONDI){
    for(uint16_t P=POSIZIONE();P<=GRADI;P++){
    SCRIVI_POSIZIONE(P);
    delay(PERIODO_IN_MILLISECONDI);
    }
  }
  void DIMINUISCI_POSIZIONE(const uint8_t &GRADI,const uint16_t &PERIODO_IN_MILLISECONDI){
    for(int16_t P=POSIZIONE();P>=GRADI;P--){
    SCRIVI_POSIZIONE(P);
    delay(PERIODO_IN_MILLISECONDI);
    }
  }
  void SWIPE_AVANTI()override{IMPOSTA_POSIZIONE(POSIZIONE_AVANTI, PERIODO_SPOSTAMENTO_IN_MILLISECONDI);}
  void SWIPE_INDIETRO()override{IMPOSTA_POSIZIONE(POSIZIONE_INDIETRO, PERIODO_SPOSTAMENTO_IN_MILLISECONDI);}
public:
 uint16_t PERIODO_SPOSTAMENTO_IN_MILLISECONDI;
 void IMPOSTA_POSIZIONE(uint16_t GRADI,uint16_t PERIODO_IN_MILLISECONDI){
  if(PERIODO_IN_MILLISECONDI>0){
   AUMENTA_POSIZIONE(GRADI,PERIODO_IN_MILLISECONDI);
   DIMINUISCI_POSIZIONE(GRADI,PERIODO_IN_MILLISECONDI);
  }
  else{SCRIVI_POSIZIONE(GRADI);}
 }
 void SWIPING(uint8_t POSIZIONE_AVANTI, uint8_t POSIZIONE_INDIETRO,uint16_t TEMPO_DA_FERMO, UNITA_DI_TEMPO UNITA){
  this->POSIZIONE_AVANTI = POSIZIONE_AVANTI;
  this->POSIZIONE_INDIETRO = POSIZIONE_INDIETRO;
  MOTORE_SWIPING::SWIPING(TEMPO_DA_FERMO,UNITA);
 }
 SERVOMOTORE(uint8_t PIN):Servo(),MOTORE_SWIPING(){
  this->PIN = PIN;
  /*NON SI PUO USARE LA FUNZIONE "attach" PRIMA DEL SETUP,
  IPOTIZZO CHE PRIMA DEL SETUP NON VENGONO INIZIALIZZATE LE FUNZIONI PRINCIPALI DELL'AMBIENTE DI SVILUPPO,
  QUINDI VERRA ESEGUITO LA PRIMA VOLTA CHE SI USA IL SERVOMOTORE*/
 }
};

#endif
